/**
 * esp32_bridge.ino — micro-ROS UART↔UDP bridge with HDLC strip/wrap
 *
 * UART→UDP: strip HDLC framing, send raw XRCE-DDS
 * UDP→UART: wrap raw XRCE-DDS in HDLC frame (CRC16-MODBUS)
 */

#include <WiFi.h>
#include <WiFiUdp.h>

const char* WIFI_SSID  = "Auro_IoT";
const char* WIFI_PASS  = "Scomm@lora";
const char* AGENT_IP   = "10.10.8.110";
const int   AGENT_PORT = 8888;
const int   LOCAL_PORT = 8889;

const int   UART_RX    = 17;
const int   UART_TX    = 18;
const int   UART_BAUD  = 921600;

WiFiUDP udp;
uint8_t uart_buf[4096];
uint8_t udp_buf[4096];
uint8_t frame_buf[4096];
int     frame_pos = 0;

/* CRC16-MODBUS (poly 0x8005, reflected, init 0x0000) — matches uxr_update_crc */
static const uint16_t crc16_tab[] = {
    0x0000,0xC0C1,0xC181,0x0140,0xC301,0x03C0,0x0280,0xC241,
    0xC601,0x06C0,0x0780,0xC741,0x0500,0xC5C1,0xC481,0x0440,
    0xCC01,0x0CC0,0x0D80,0xCD41,0x0F00,0xCFC1,0xCE81,0x0E40,
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    0x8201,0x42C0,0x4380,0x8341,0x4100,0x81C1,0x8081,0x4040
};

static uint16_t crc16_update(uint16_t crc, uint8_t b)
{
    return crc16_tab[(crc ^ b) & 0xFF] ^ (crc >> 8);
}

static uint16_t crc16_compute(const uint8_t *data, size_t len)
{
    uint16_t crc = 0x0000;
    for (size_t i = 0; i < len; i++)
        crc = crc16_update(crc, data[i]);
    return crc;
}

void setup() {
    Serial.begin(115200);
    delay(500);
    Serial.println("=== micro-ROS UART-UDP bridge (HDLC CRC-MODBUS) ===");

    Serial1.begin(UART_BAUD, SERIAL_8N1, UART_RX, UART_TX);
    Serial.printf("UART: RX=GPIO%d TX=GPIO%d @ %d\n", UART_RX, UART_TX, UART_BAUD);

    WiFi.mode(WIFI_STA);
    WiFi.begin(WIFI_SSID, WIFI_PASS);
    Serial.printf("WiFi: %s ", WIFI_SSID);
    while (WiFi.status() != WL_CONNECTED) { delay(200); Serial.print("."); }
    Serial.printf("\nIP: %s\n", WiFi.localIP().toString().c_str());

    udp.begin(LOCAL_PORT);
    Serial.printf("UDP -> %s:%d\nBridge running.\n", AGENT_IP, AGENT_PORT);
}

void loop() {
    /* ── UART → UDP: strip HDLC, forward raw XRCE-DDS ────────────── */
    while (Serial1.available()) {
        uint8_t b = Serial1.read();

        if (b == 0x7E) {
            if (frame_pos >= 7) {
                /* Frame: [src][dst][len_lo][len_hi][payload...][crc_lo][crc_hi] */
                int xrce_len = frame_pos - 4 - 2;
                if (xrce_len > 0) {
                    udp.beginPacket(AGENT_IP, AGENT_PORT);
                    udp.write(&frame_buf[4], xrce_len);
                    udp.endPacket();
                }
            }
            frame_pos = 0;
            continue;
        }
        if (frame_pos < (int)sizeof(frame_buf))
            frame_buf[frame_pos++] = b;
    }

    /* ── UDP → UART: wrap raw XRCE-DDS in HDLC ────────────────────── */
    int p = udp.parsePacket();
    if (p > 0) {
        int r = udp.read(udp_buf, sizeof(udp_buf));
        if (r > 0) {
            Serial.printf("UDP RX: %d bytes -> UART\n", r);
            /* HDLC: [0x7E][src=0][dst=0][len_lo][len_hi][payload][crc_lo][crc_hi] */
            uint8_t hdr[5] = {0x7E, 0x00, 0x00,
                              (uint8_t)(r & 0xFF),
                              (uint8_t)((r >> 8) & 0xFF)};

            /* CRC over: payload only (length NOT included) */
            uint16_t crc = 0;
            for (int i = 0; i < r; i++)
                crc = crc16_update(crc, udp_buf[i]);

            Serial1.write(hdr, 5);
            Serial1.write(udp_buf, r);
            uint8_t crc_bytes[2] = {(uint8_t)(crc & 0xFF), (uint8_t)((crc >> 8) & 0xFF)};
            Serial1.write(crc_bytes, 2);
        }
    }
}
